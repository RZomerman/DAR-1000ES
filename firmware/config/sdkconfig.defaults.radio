## firmware/config/sdkconfig.defaults.radio
```kconfig
CONFIG_AUDIO_OUTPUT_SPDIF=y
CONFIG_SONY_SCREEN_BENCH=y
CONFIG_SONY_MANUAL_CONTROLS=n
CONFIG_SONY_I2S_MIRROR=n
CONFIG_SPDIF_DO_IO=42
CONFIG_I2S_SCK_IO=-1
CONFIG_I2S_BCK_IO=-1
CONFIG_I2S_WS_IO=-1
CONFIG_I2S_DO_IO=-1
CONFIG_LED_RGB_GPIO=48
CONFIG_BAT_CHANNEL=-1
CONFIG_I2S_GND_IO=-1
CONFIG_OUTPUT_SAMPLE_RATE_48000=y
CONFIG_ESPTOOLPY_FLASHMODE_DIO=y
CONFIG_MBEDTLS_CERTIFICATE_BUNDLE=y
CONFIG_AUDIO_DECODER_G711_SUPPORT=n
CONFIG_AUDIO_DECODER_AMRNB_SUPPORT=n
CONFIG_AUDIO_DECODER_AMRWB_SUPPORT=n
CONFIG_AUDIO_DECODER_FLAC_SUPPORT=n
CONFIG_AUDIO_DECODER_OPUS_SUPPORT=n
CONFIG_AUDIO_DECODER_VORBIS_SUPPORT=n
CONFIG_AUDIO_DECODER_ADPCM_SUPPORT=n
CONFIG_AUDIO_DECODER_ALAC_SUPPORT=n
CONFIG_AUDIO_DECODER_PCM_SUPPORT=n
CONFIG_AUDIO_DECODER_SBC_SUPPORT=n
CONFIG_AUDIO_DECODER_LC3_SUPPORT=n
CONFIG_AUDIO_DECODER_G722_SUPPORT=n
CONFIG_AUDIO_SIMPLE_DEC_WAV_SUPPORT=n
CONFIG_AUDIO_SIMPLE_DEC_M4A_SUPPORT=n
CONFIG_AUDIO_SIMPLE_DEC_TS_SUPPORT=n
CONFIG_AUDIO_SIMPLE_DEC_OGG_SUPPORT=n
CONFIG_PARTITION_TABLE_CUSTOM_FILENAME="components/boards/partitions-radio.csv"
```
