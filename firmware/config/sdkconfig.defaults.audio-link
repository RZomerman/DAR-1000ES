## firmware/config/sdkconfig.defaults.audio-link
```kconfig
CONFIG_SONY_UART_LINK=y
CONFIG_ESP_CONSOLE_USB_SERIAL_JTAG=y
CONFIG_ESP_CONSOLE_SECONDARY_NONE=y
CONFIG_ESP_SYSTEM_PANIC_REBOOT_DELAY_SECONDS=3
CONFIG_SONY_UART_AUDIO_NODE=y
CONFIG_SONY_SCREEN_BENCH=n
CONFIG_SONY_MANUAL_CONTROLS=n
CONFIG_SONY_I2S_MIRROR=n
CONFIG_AUDIO_OUTPUT_SPDIF=n
CONFIG_LED_RGB_GPIO=-1
CONFIG_ESPTOOLPY_FLASHMODE_DIO=y
CONFIG_PARTITION_TABLE_CUSTOM_FILENAME="components/boards/partitions-radio.csv"
```

## firmware/config/sdkconfig.defaults.audio-pcm-bench
```kconfig
CONFIG_SONY_I2S_MIRROR=y
CONFIG_I2S_BCK_IO=42
CONFIG_I2S_WS_IO=41
CONFIG_I2S_DO_IO=40
```

## firmware/config/sdkconfig.defaults.audio-radio
```kconfig
CONFIG_SONY_SCREEN_BENCH=n
CONFIG_SONY_UART_LINK=y
CONFIG_SONY_SPLIT_AUDIO_NODE=y
CONFIG_LED_RGB_GPIO=-1
CONFIG_SPDIF_DO_IO=15
```

## firmware/config/sdkconfig.defaults.controller
```kconfig
CONFIG_SONY_CONTROLLER_NODE=y
CONFIG_SONY_UART_LINK=y
CONFIG_SONY_SCREEN_BENCH=y
CONFIG_ESP_CONSOLE_USB_SERIAL_JTAG=y
CONFIG_ESP_CONSOLE_SECONDARY_NONE=y
CONFIG_SONY_MANUAL_CONTROLS=n
CONFIG_SONY_I2S_MIRROR=n
CONFIG_ESPTOOLPY_FLASHMODE_DIO=y
CONFIG_MBEDTLS_CERTIFICATE_BUNDLE=y
CONFIG_PARTITION_TABLE_CUSTOM_FILENAME="components/boards/partitions-radio.csv"
```
